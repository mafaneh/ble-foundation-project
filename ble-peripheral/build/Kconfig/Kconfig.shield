## ble-peripheral/build/Kconfig/Kconfig.shield
```kconfig
osource "/Users/mafaneh/Projects/ncs/peripheral_lbs/boards/shields/*/Kconfig.shield"
osource "/opt/nordic/ncs/v2.2.0/nrf/boards/shields/*/Kconfig.shield"
```

## ble-peripheral/build/Kconfig/Kconfig.shield.defconfig
```kconfig
osource "/Users/mafaneh/Projects/ncs/peripheral_lbs/boards/shields/*/Kconfig.defconfig"
osource "/opt/nordic/ncs/v2.2.0/nrf/boards/shields/*/Kconfig.defconfig"
```
